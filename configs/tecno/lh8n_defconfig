## configs/tecno/lh8n_defconfig
```kconfig
CONFIG_APP_ADDRESS=0x4822ECB8
CONFIG_BOOTLOADER_BASE=0x48200000
CONFIG_BOOTLOADER_SIZE=0x129B58
CONFIG_BOOTMODE_ADDRESS=0x4832C598
CONFIG_FASTBOOT_FAIL_ADDRESS=0x4822F6EC
CONFIG_FASTBOOT_INFO_ADDRESS=0x4822F644
CONFIG_FASTBOOT_OKAY_ADDRESS=0x4822F8C8
CONFIG_FASTBOOT_PUBLISH_ADDRESS=0x4822F2D0
CONFIG_FASTBOOT_REGISTER_ADDRESS=0x4822F294
CONFIG_INIT_STORAGE_ADDRESS=0x482025DC
CONFIG_INIT_STORAGE_CALLER=0x4820271A
CONFIG_PLATFORM_INIT_ADDRESS=0x482026EC
CONFIG_PLATFORM_INIT_CALLER=0x4822AB32
CONFIG_PARTITION_GET_SIZE_BY_NAME_ADDRESS=0x48259C8C
CONFIG_PARTITION_READ_ADDRESS=0x4825AF0C
CONFIG_MTK_DETECT_KEY_ADDRESS=0x4820478C
CONFIG_THREAD_CREATE_ADDRESS=0x4822B378
CONFIG_VIDEO_PRINTF_ADDRESS=0x4823C9F8
CONFIG_LK_LOG_STORE_ADDRESS=0x48252EAC
CONFIG_DPRINTF_ADDRESS=0x4823CE1C
CONFIG_MALLOC_ADDRESS=0x4823DC14
CONFIG_FREE_ADDRESS=0x4823D250
CONFIG_GET_ENV_ADDRESS=0x48259FB0
CONFIG_SET_ENV_ADDRESS=0x4825A1C8
CONFIG_FRAMEBUFFER_ADDRESS=0x76950000
CONFIG_FRAMEBUFFER_ALIGNMENT=64
CONFIG_FRAMEBUFFER_BPP=32
CONFIG_FRAMEBUFFER_HEIGHT=2460
CONFIG_FRAMEBUFFER_SUPPORT=n
CONFIG_FRAMEBUFFER_WIDTH=1080
CONFIG_ENVIRONMENT_SUPPORT=y
CONFIG_THREAD_CREATE_ADDRESS=0x4822B378
CONFIG_THREAD_RESUME_ADDRESS=0x44822B590
CONFIG_MEDIATEK_MT6833=y
CONFIG_STAGE1_SUPPORT=y
CONFIG_THREAD_SUPPORT=y
CONFIG_TECNO_LH8N=y
CONFIG_LEGACY_LK=n
```
